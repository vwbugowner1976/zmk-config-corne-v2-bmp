## boards/arm/ble_micro_pro/Kconfig.defconfig
```kconfig
# SPDX-License-Identifier: MIT

if BOARD_BLE_MICRO_PRO

config BOARD
    default "ble_micro_pro"

if USB_DEVICE_STACK

config USB_NRFX
    default y

endif # USB_DEVICE_STACK

config BT_CTLR
    default BT

endif # BOARD_BLE_MICRO_PRO
```

## boards/arm/ble_micro_pro/ble_micro_pro_defconfig
```kconfig
# SPDX-License-Identifier: MIT

CONFIG_SOC_SERIES_NRF52X=y
CONFIG_SOC_NRF52840_QIAA=y
CONFIG_BOARD_BLE_MICRO_PRO=y

CONFIG_ARM_MPU=y
CONFIG_GPIO=y
CONFIG_PINCTRL=y

CONFIG_USE_DT_CODE_PARTITION=y
CONFIG_BUILD_OUTPUT_UF2=y

CONFIG_MPU_ALLOW_FLASH_WRITE=y
CONFIG_NVS=y
CONFIG_SETTINGS_NVS=y
CONFIG_FLASH=y
CONFIG_FLASH_PAGE_LAYOUT=y
CONFIG_FLASH_MAP=y

# BL654 on the original BLE Micro Pro has no external 32.768 kHz crystal.
CONFIG_CLOCK_CONTROL_NRF=y
CONFIG_CLOCK_CONTROL_NRF_K32SRC_RC=y

# Enable the nRF52 DC/DC converter.
CONFIG_SOC_DCDC_NRF52X=y

CONFIG_ZMK_USB=y
CONFIG_ZMK_BLE=y
```

## west.yml
```yaml
manifest:
  remotes:
    - name: cormoran
      url-base: https://github.com/cormoran
    - name: vwbugowner1976
      url-base: https://github.com/vwbugowner1976

  projects:
    - name: zmk
      remote: cormoran
      revision: v0.3-branch+dya
      import: app/west.yml

    - name: zmk-feature-custom-settings
      remote: vwbugowner1976
      repo-path: zmk-feature-custom-settings-v03
      revision: main
      path: modules/zmk-feature-custom-settings

  self:
    path: config
```
